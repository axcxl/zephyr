## drivers/sensor/htu21d/Kconfig
```kconfig
# Copyright (c) 2016 Intel Corporation
# SPDX-License-Identifier: Apache-2.0

menuconfig HTU21D
	bool "HTU21D temperature and humidity sensor"
	depends on I2C && HAS_DTS_I2C
	help
	  Enable driver for I2C version of HTU21 temperature and humidity sensor.

if HTU21D

#TODO 

endif # HTU21D
```

## dts/bindings/sensor/ms,htu21d.yaml
```yaml
# Copyright (c) 2017, Linaro Limited
# SPDX-License-Identifier: Apache-2.0

description: Measurement Specialties HTU21D humidity and temperature sensor

compatible: "ms,htu21d"

include: i2c-device.yaml
```
